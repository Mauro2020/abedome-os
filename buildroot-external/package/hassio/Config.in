## buildroot-external/package/hassio/Config.in
```kconfig
menuconfig BR2_PACKAGE_HASSIO
	bool "Supervisor App"
	help
	  This is the Application layer they build the
	  data partition with configurations.

	  https://github.com/home-assistant/supervisor

if BR2_PACKAGE_HASSIO

config BR2_PACKAGE_HASSIO_ARCH
	string "Supervisor Arch"
	help
	  Supervisor architecture which should be pull.

config BR2_PACKAGE_HASSIO_MACHINE
	string "Supervisor Machine"
	help
	  Machine to pull containers for (used for landing page).

config BR2_PACKAGE_HASSIO_SUPERVISOR_IMAGE
	string "Preloaded Supervisor OCI image"
	default ""
	help
	  Optional full image reference including an immutable test tag, for example:
	  ghcr.io/mauro2020/abedome-supervisor:pve-e6a5f6fa3cc8

	  When set, this image is preloaded as the initial Supervisor image. Leave it
	  empty to use the Supervisor image from the selected Home Assistant channel.

config BR2_PACKAGE_HASSIO_SUPERVISOR_VERSION_URL
	string "Supervisor update-feed URL template"
	default ""
	help
	  Optional HTTPS URL template used by the Supervisor to discover approved
	  updates. The template must contain {channel}, for example:
	  https://updates.example.invalid/{channel}.json

	  Leave this empty to keep Home Assistant's standard update source. This
	  setting does not enable automatic ABEDOME updates by itself.

choice
	prompt "Default Channel"
	default BR2_PACKAGE_HASSIO_CHANNEL_STABLE
	help
	  Channel to use by default.

config BR2_PACKAGE_HASSIO_CHANNEL_STABLE
	bool "Stable"
	help
	  Stable channel.

config BR2_PACKAGE_HASSIO_CHANNEL_BETA
	bool "Beta"
	help
	  Beta channel.

config BR2_PACKAGE_HASSIO_CHANNEL_DEV
	bool "Dev"
	help
	  Dev channel.

endchoice

endif
```
